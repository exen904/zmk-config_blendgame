## config/boards/shields/entgame/Kconfig.defconfig
```kconfig
# Copyright (c) 2021 The ZMK Contributors
# SPDX-License-Identifier: MIT

if SHIELD_ENTGAME

config ZMK_KEYBOARD_NAME
    default "The Entgame"

endif
```

## config/boards/shields/entgame/Kconfig.shield
```kconfig
# Copyright (c) 2021 The ZMK Contributors
# SPDX-License-Identifier: MIT

config SHIELD_ENTGAME
    def_bool $(shields_list_contains,entgame)
ZMK_STUDIO=y
CONFIG_BT_MAX_CONN=2
CONFIG_BT_MAX_PAIRED=2
```
